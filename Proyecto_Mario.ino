#include "VGA.h"
#include <stdio.h>     
#include <stdlib.h>     
#include <time.h>
#include "Renderer.h"
#include "Enemy.h"
#include "Spaceship.h"

#define LineAmount 6
#define ObstaculeAmount 5
#define XPositionAmount 3
#define PointInRectangle(x, y, x1, y1, x2, y2)		((( (x) >= (x1)) && ((y) >= (y1))) && (((x) <= (x2)) && ((y) <= (y2))))

//int Collide(struct Rectangle *r1, struct Rectangle *r2)
//{
//	return (PointInRectangle(r1->x1, r1->y1, r2->x1, r2->y1, r2->x2, r2->y2) ||
//		PointInRectangle(r1->x2, r1->y2, r2->x1, r2->y1, r2->x2, r2->y2) ||
//		PointInRectangle(r1->x1, r1->y2, r2->x1, r2->y1, r2->x2, r2->y2) ||
//		PointInRectangle(r1->x2, r1->y1, r2->x1, r2->y1, r2->x2, r2->y2));
//}
unsigned char SpaceShip[] = {
BLACK,BLACK,BLACK,BLACK,BLACK,BLACK,BLACK,WHITE,WHITE,BLACK,BLACK,BLACK,BLACK,BLACK,BLACK,BLACK,
BLACK,BLACK,BLACK,BLACK,BLACK,BLACK,BLACK,WHITE,WHITE,BLACK,BLACK,BLACK,BLACK,BLACK,BLACK,BLACK,
BLACK,BLACK,BLACK,BLACK,BLACK,BLACK,BLACK,WHITE,WHITE,BLACK,BLACK,BLACK,BLACK,BLACK,BLACK,BLACK,
BLACK,BLACK,BLACK,BLACK,BLACK,BLACK,BLACK,WHITE,WHITE,BLACK,BLACK,BLACK,BLACK,BLACK,BLACK,BLACK,
BLACK,BLACK,BLACK,RED,RED,BLACK,WHITE,WHITE,WHITE,WHITE,BLACK,RED,RED,BLACK,BLACK,BLACK,
BLACK,BLACK,BLACK,RED,RED,BLACK,WHITE,WHITE,WHITE,WHITE,BLACK,RED,RED,BLACK,BLACK,BLACK,
BLACK,BLACK,BLACK,WHITE,WHITE,BLACK,WHITE,WHITE,WHITE,WHITE,BLACK,WHITE,WHITE,BLACK,BLACK,BLACK,
BLACK,BLACK,BLACK,WHITE,WHITE,BLACK,WHITE,RED,RED,WHITE,BLACK,WHITE,WHITE,BLACK,BLACK,BLACK,
RED,RED,BLACK,BLUE,BLUE,BLACK,WHITE,RED,RED,WHITE,BLACK,BLUE,BLUE,BLACK,RED,RED,
RED,RED,BLACK,BLUE,BLUE,BLACK,RED,RED,RED,RED,BLACK,BLUE,BLUE,BLACK,RED,RED,
WHITE,WHITE,BLACK,WHITE,WHITE,WHITE,RED,WHITE,WHITE,RED,WHITE,WHITE,WHITE,BLACK,WHITE,WHITE,
WHITE,WHITE,WHITE,WHITE,WHITE,WHITE,RED,WHITE,WHITE,RED,WHITE,WHITE,WHITE,WHITE,WHITE,WHITE,
WHITE,WHITE,WHITE,WHITE,WHITE,WHITE,WHITE,WHITE,WHITE,WHITE,WHITE,WHITE,WHITE,WHITE,WHITE,WHITE,
WHITE,WHITE,WHITE,WHITE,BLACK,RED,RED,WHITE,WHITE,RED,RED,BLACK,WHITE,WHITE,WHITE,WHITE,
WHITE,WHITE,WHITE,WHITE,BLACK,RED,RED,WHITE,WHITE,RED,RED,BLACK,WHITE,WHITE,WHITE,WHITE,
WHITE,WHITE,BLACK,BLACK,BLACK,BLACK,BLACK,WHITE,WHITE,BLACK,BLACK,BLACK,BLACK,BLACK,WHITE,WHITE
};

unsigned char Heart[]=
{
    GREEN,GREEN,BLACK,BLACK,GREEN,BLACK,BLACK,GREEN,GREEN,
    GREEN,BLACK,RED,RED,BLACK,RED,RED,BLACK,GREEN,
    BLACK,RED,RED,RED,RED,RED,RED,RED,BLACK,
    BLACK,RED,RED,RED,RED,RED,RED,RED,BLACK,
    GREEN,BLACK,RED,RED,RED,RED,RED,BLACK,GREEN,
    GREEN,GREEN,BLACK,RED,RED,RED,BLACK,GREEN,GREEN,
    GREEN,GREEN,GREEN,BLACK,RED,BLACK,GREEN,GREEN,GREEN,
    GREEN,GREEN,GREEN,GREEN,BLACK,GREEN,GREEN,GREEN,GREEN,
};

unsigned char bee[] = {BLACK, BLUE, BLACK, BLACK,BLACK, BLACK, YELLOW, BLACK, BLACK,BLACK, BLACK,BLUE, BLACK,
                          BLACK, BLACK, BLUE, BLACK,YELLOW, RED, YELLOW, RED, YELLOW,BLACK, BLUE,BLACK, BLACK,
                          BLACK, BLACK, BLACK, BLUE,RED, RED, YELLOW, RED, RED,BLUE, BLACK,BLACK, BLACK,
                          BLACK, BLACK, BLACK, BLACK,YELLOW, YELLOW, YELLOW, YELLOW, YELLOW,BLACK, BLACK,BLACK, BLACK,
                          BLACK, BLACK, BLACK, BLUE,BLUE, YELLOW, YELLOW, YELLOW, BLUE,BLUE, BLACK,BLACK, BLACK,
                          BLACK, BLACK, BLUE, BLUE,BLUE, RED, RED, RED, BLUE,BLUE, BLUE,BLACK, BLACK,
                          BLACK, BLUE, BLUE, BLUE,BLACK, RED, RED, RED, BLACK,BLUE, BLUE,BLUE, BLACK,
                          BLUE, BLUE, BLUE, BLUE,BLACK, YELLOW, YELLOW, YELLOW, BLACK,BLUE, BLUE,BLUE, BLUE,
                          BLUE, BLUE, BLUE, BLACK,BLACK, RED, RED, RED, BLACK,BLACK, BLUE,BLUE, BLUE,
                          BLUE, BLUE, BLUE, BLACK,BLACK, BLACK, RED, BLACK, BLACK,BLACK, BLUE,BLUE, BLUE,};

void setup(){
   srand(0);
  VGA.begin(VGAWISHBONESLOT(9),CHARMAPWISHBONESLOT(10));
  Serial.begin(9600);
  
  
}
 Renderer renderer;
 Enemy enemy(0,0, bee);
 Spaceship spaceship1(100,SpaceShip);
 Spaceship spaceship2(40, SpaceShip);

void loop(){

  renderer.render(&enemy);
  renderer.render(&spaceship1);
  renderer.render(&spaceship2);
  //VGA.writeArea(xCoor,0,13,10,bee);
  //VGA.writeArea(SpaceX, 80, 16,16, SpaceShip);
  delay(75);
  if(digitalRead(FPGA_BTN_1))
    spaceship1.x += 16;
  else if(digitalRead(FPGA_BTN_0))
    spaceship1.x -= 16;
    
  if(digitalRead(FPGA_BTN_3))
    spaceship2.x += 16;
  else if(digitalRead(FPGA_BTN_2))
    spaceship2.x -= 16;
  
  enemy.x += 16;
  VGA.clear();
  
}
